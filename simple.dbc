VERSION ""

NS_ :

BS_:

BU_:

BO_ 100 Test_Message: 8 Vector__XXX
 SG_ Signal1 : 0|8@1+ (1,0) [0|255] "" Vector__XXX
 SG_ Signal2 : 8|8@1+ (1,0) [0|255] "" Vector__XXX
